## config/west.yml
```yaml
manifest:
  remotes:
    - name: zmkfirmware
      url-base: https://github.com/zmkfirmware
    - name: nickconway # 换用这个经过社区验证且公开的驱动地址
      url-base: https://github.com/nickconway
   
  projects:
    - name: zmk
      remote: zmkfirmware
      revision: v0.3
      import: app/west.yml
    - name: zmk-display-gc9a01
      remote: nickconway
      revision: main
      
  self:
    path: config
```
